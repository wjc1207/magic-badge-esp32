## main/Kconfig.projbuild
```kconfig
menu "MagicBadge Optional Hardware Tools"

    config MIMI_TOOL_RGB_ENABLED
        bool "Enable RGB control tool"
        default y
        help
            Build RGB component and register tool_rgb_control/rgb_control Lua libraries.

    config MIMI_TOOL_CAMERA_ENABLED
        bool "Enable camera capture tool"
        default n
        help
            Build camera component and register lua_modulo_camera/camera_core Lua libraries.

    config MIMI_CAMERA_SERVER_ENABLED
        bool "Enable camera debug HTTP server"
        depends on MIMI_TOOL_CAMERA_ENABLED
        default n
        help
            Build camera HTTP server with /capture endpoint for debug.

    config MIMI_TOOL_BLE_ENABLED
        bool "Enable BLE listener tool"
        default n
        help
            Build BLE component and register tool_ble_listener/bthome_listener Lua libraries.

endmenu
```
